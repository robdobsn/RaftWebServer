## examples/basic/systypes/BasicWebServer/sdkconfig.defaults
```kconfig
# Define configuration
# Remove/repace these comments to set level to debug/info

# Flash size
CONFIG_ESPTOOLPY_FLASHSIZE_4MB=y

# Serial Baud-Rate
CONFIG_ESP_CONSOLE_UART_BAUDRATE=115200

# Partition Table
CONFIG_PARTITION_TABLE_CUSTOM=y
CONFIG_PARTITION_TABLE_CUSTOM_FILENAME="build/raft/partitions.csv"

# LWIP
CONFIG_LWIP_LOCAL_HOSTNAME="basicwebexample"
CONFIG_LWIP_SO_RCVBUF=y
CONFIG_LWIP_SO_LINGER=y
CONFIG_LWIP_L2_TO_L3_COPY=y
CONFIG_LWIP_MAX_SOCKETS=16

# FreeRTOS
CONFIG_FREERTOS_HZ=1000
CONFIG_FREERTOS_USE_TRACE_FACILITY=y
CONFIG_FREERTOS_USE_STATS_FORMATTING_FUNCTIONS=y
CONFIG_FREERTOS_VTASKLIST_INCLUDE_COREID=y
CONFIG_FREERTOS_GENERATE_RUN_TIME_STATS=y

# Uncomment the following for heap-tracing support
#CONFIG_HEAP_TRACING_OFF=y
#CONFIG_HEAP_TRACING_STANDALONE=y
#CONFIG_HEAP_TRACING_STACK_DEPTH=5

# Compiler options: use -Os to reduce size, but keep full assertions
CONFIG_COMPILER_OPTIMIZATION_SIZE=n
```

## examples/perftest/sdkconfig.defaults
```kconfig
# Define configuration
# Remove/repace these comments to set level to debug/info

# Main task
CONFIG_ESP_MAIN_TASK_STACK_SIZE=16384

# Serial Baud-Rate
CONFIG_ESP_CONSOLE_UART_BAUDRATE=115200

# Partition Table
CONFIG_PARTITION_TABLE_CUSTOM=y
CONFIG_PARTITION_TABLE_CUSTOM_FILENAME="partitions.csv"

# LWIP
#CONFIG_LWIP_LOCAL_HOSTNAME="basicwebexample"
#CONFIG_LWIP_SO_RCVBUF=y
#CONFIG_LWIP_SO_LINGER=y
#CONFIG_LWIP_L2_TO_L3_COPY=y
#CONFIG_LWIP_MAX_SOCKETS=16

# FreeRTOS
CONFIG_FREERTOS_HZ=1000
CONFIG_FREERTOS_USE_TRACE_FACILITY=y
CONFIG_FREERTOS_USE_STATS_FORMATTING_FUNCTIONS=y
CONFIG_FREERTOS_VTASKLIST_INCLUDE_COREID=y
CONFIG_FREERTOS_GENERATE_RUN_TIME_STATS=y

# Uncomment the following for heap-tracing support
#CONFIG_HEAP_TRACING_OFF=y
#CONFIG_HEAP_TRACING_STANDALONE=y
#CONFIG_HEAP_TRACING_STACK_DEPTH=5

# Compiler options: use -Os to reduce size, but keep full assertions
CONFIG_COMPILER_OPTIMIZATION_SIZE=n

# To reduce iRAM usage
# CONFIG_ESP32_WIFI_IRAM_OPT=n
# CONFIG_ESP32_WIFI_RX_IRAM_OPT=n
```
